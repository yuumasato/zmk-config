## config/west.yml
```yaml
manifest:
  remotes:
    - name: zmk
      url-base: https://github.com/yuumasato
  projects:
    - name: zmk
      remote: zmk
      revision: kyria3
      import: app/west.yml
  self:
    path: config
```
